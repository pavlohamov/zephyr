## boards/shields/ili9340_generic/Kconfig.defconfig
```kconfig
# Copyright (c) 2019 Linaro Limited
# Copyright (c) 2020 Pavlo Hamov <pasha.gamov@gmail.com>
# SPDX-License-Identifier: Apache-2.0

if SHIELD_ILI9340_ADAFRUIT_2_8_TFTV2 || SHIELD_ILI9340_SEEED_2_8_TFTV2

if DISPLAY

config SPI
	default y

config ILI9340
	default y

if LVGL

config LVGL_DISPLAY_DEV_NAME
	default "ILI9340"

config LVGL_HOR_RES
	default 320

config LVGL_VER_RES
	default 240

config LVGL_VDB_SIZE
	default 10

config LVGL_BITS_PER_PIXEL
	default 24

endif # LVGL

endif # DISPLAY

endif # SHIELD_ILI9340_ADAFRUIT_2_8_TFTV2 || SHIELD_ILI9340_SEEED_2_8_TFTV2
```

## boards/shields/ili9340_generic/Kconfig.shield
```kconfig
# Copyright (c) 2019 Linaro Limited
# Copyright (c) 2020 Pavlo Hamov <pasha.gamov@gmail.com>
# SPDX-License-Identifier: Apache-2.0

config SHIELD_ILI9340_ADAFRUIT_2_8_TFTV2
	def_bool $(shields_list_contains,ili9340_adafruit_2_8_tftv2)

config SHIELD_ILI9340_SEEED_2_8_TFTV2
	def_bool $(shields_list_contains,ili9340_seeed_2_8_tftv2)
```

## drivers/display/Kconfig.ili9340
```kconfig
# ILI9340 display driver configuration options

# Copyright (c) 2017 Jan Van Winkel <jan.van_winkel@dxplore.eu>
# SPDX-License-Identifier: Apache-2.0

menuconfig ILI9340
	bool "ILI9340 display driver"
	depends on SPI
	help
	  Enable driver for ILI9340 display driver.

if ILI9340

choice
	prompt "Color pixel format"
	help
	  Specify the color pixel format of the ILI9340 display controller.

config ILI9340_RGB888
	bool "RGB888"

config ILI9340_RGB565
	bool "RGB565"

endchoice

endif # ILI9340
```

## dts/bindings/display/ilitek,ili9xxx.yaml
```yaml
# Copyright (c) 2018, Jan Van Winkel <jan.van_winkel@dxplore.eu>
# Copyright (c) 2020, Pavlo Hamov <pasha.gamov@gmail.com>
# SPDX-License-Identifier: Apache-2.0

description: ILI9xxx display controller

compatible: "ilitek,ili9xxx"

include: spi-device.yaml

properties:
    type:
      type: string
      required: true
      description: controller type
      enum:
        - "ili9163"
        - "ili9340"
        - "ili9341"

    reset-gpios:
      type: phandle-array
      required: false
      description: RESET pin.

        The RESET pin of ILI9340 is active low.
        If connected directly the MCU pin should be configured
        as active low.

    cmd-data-gpios:
      type: phandle-array
      required: true
      description: D/CX pin.

        The D/CX pin of ILI9340 is active low (transmission command byte).
        If connected directly the MCU pin should be configured
        as active low.

    pixel-format:
      type: string
      required: false
      description: pixel data format
      enum:
        - "RGB565"
        - "RGB888"
      default: "RGB565"

    height:
      type: int
      required: true
      description: Height in pixels of the panel driven by the controller

    width:
      type: int
      required: true
      description: Width in pixels of the panel driven by the controller

    x-offset:
      type: int
      required: false
      description: The column offset in pixels of the LCD to the controller memory

    y-offset:
      type: int
      required: false
      description: The row offset in pixels of the LCD to the controller memory

    power-ctrl-1:
      type: uint8-array
      required: false
      description: power control 1

    power-ctrl-2:
      type: uint8-array
      required: false
      description: power control 2

    power-ctrl-a:
      type: uint8-array
      required: false
      description: Power control A

    power-ctrl-b:
      type: uint8-array
      required: false
      description: Power control B

    vcom-ctrl-1:
      type: uint8-array
      required: false
      description: vcom control 1

    vcom-ctrl-2:
      type: uint8-array
      required: false
      description: vcom control 2

    power-on-seq-ctrl:
      type: uint8-array
      required: false
      description: PowerOn sequence control

    drvr-timing-ctrl-a-i:
      type: uint8-array
      required: false
      description: Driver timing

    drvr-timing-ctrl-b:
      type: uint8-array
      required: false
      description: Driver timing

    pump-ratio-ctrl:
      type: uint8-array
      required: false
      description: Pump ratio control

    mem-access-ctrl:
      type: uint8-array
      required: false
      description: Memory Access Data Control

    frame-ctrl-normal-mode:
      type: uint8-array
      required: false
      description: Frame Rate

    display-function-ctrl:
      type: uint8-array
      required: false
      description: Display Function Control

    enable-3g:
      type: uint8-array
      required: false
      description: 3Gamma Function

    gamma-set:
      type: uint8-array
      required: false
      description: Gamma curve selected

    positive-gamma-correction:
      type: uint8-array
      required: false
      description: Positive Gamma Correction

    negative-gamma-correction:
      type: uint8-array
      required: false
      description: Negative Gamma Correction
```
